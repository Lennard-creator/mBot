// generated by mBlock5 for mBot
// codes make you happy

#include <MeMCore.h>
#include <Arduino.h>
#include <Wire.h>
#include <SoftwareSerial.h>

MeLightSensor lightsensor_6(6);
MeDCMotor motor_9(9);
MeDCMotor motor_10(10);
MeLineFollower linefollower_2(2);
MeUltrasonicSensor ultrasonic_3(3);
double currentTime = 0;
double lastTime = 0;
MeIR ir;
MeLEDMatrix ledMtx_1(1);

float k = 0;

void move(int direction, int speed) {
  int leftSpeed = 0;
  int rightSpeed = 0;
  if(direction == 1) {
    leftSpeed = speed;
    rightSpeed = speed;
  } else if(direction == 2) {
    leftSpeed = -speed;
    rightSpeed = -speed;
  } else if(direction == 3) {
    leftSpeed = -speed;
    rightSpeed = speed;
  } else if(direction == 4) {
    leftSpeed = speed;
    rightSpeed = -speed;
  }
  motor_9.run((9) == M1 ? -(leftSpeed) : (leftSpeed));
  motor_10.run((10) == M1 ? -(rightSpeed) : (rightSpeed));
}
double getLastTime(){
  return currentTime = millis() / 1000.0 - lastTime;
}

void _delay(float seconds) {
  long endTime = millis() + seconds * 1000;
  while(millis() < endTime) _loop();
}

void setup() {
  ir.begin();
  ledMtx_1.setColorIndex(1);
  ledMtx_1.setBrightness(6);
  if(lightsensor_6.read() == 1.000000){

    move(1, 50 / 100.0 * 255);
    _delay(1);
    move(1, 0);

  }
  if(linefollower_2.readSensors() == 2.000000){

    move(2, 50 / 100.0 * 255);
    _delay(1);
    move(2, 0);

  }
  if(ultrasonic_3.distanceCm() < 3){

    move(3, 50 / 100.0 * 255);
    _delay(1);
    move(3, 0);

  }
  if(getLastTime() == 4.000000){
    ir.sendString("hello");
    ledMtx_1.drawStr(0, 0 + 7, String("hello").c_str());
    motor_9.run(0);
    motor_10.run(0);

    motor_9.run(-1 * 50/100.0*255);
    motor_10.run(50/100.0*255);

  }

}

void _loop() {
}

void loop() {
  _loop();
}

